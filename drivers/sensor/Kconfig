## drivers/sensor/Kconfig
```kconfig
#
#
#


menuconfig NEW_SENSORS
	bool "Sensors Support"
	help
	  Say Y to enable Sensors support.  This allows control of supported
	  Sensors.

	  
	  

if NEW_SENSORS

config ACCEL                                                              
	bool "Accelerometer Sensor"
	default y
	help
	This option enables accelerometer sensors  

source "drivers/sensor/accel/Kconfig"

source "drivers/sensor/accel_kr3dm/Kconfig"

source "drivers/sensor/compass/Kconfig"

source "drivers/sensor/optical/Kconfig"



endif # NEW_SENSORS
```
